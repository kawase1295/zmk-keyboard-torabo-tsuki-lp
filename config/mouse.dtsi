// マウス関連の独自設定（keymap-editor では編集できない領域）
// ここはファイルで手編集する。キー配置は keymap.keymap 側で編集。
#include <input/processors.dtsi>
#include <dt-bindings/zmk/input_transform.h>

// トラックボール操作時にレイヤー1を自動で有効化する挙動
&zip_temp_layer {
    require-prior-idle-ms = <300>;
    excluded-positions = <
        19 32 33 34 35 36 37 47   // マウス操作キー(クリック・スクロール)
        38 51 52 53 54 55 62 63 64 65   // 修飾キー(Ctrl+クリック等を使うため)
    >;
};

// トラックボール: 上下左右反転 + マウスレイヤー自動化
&pointing_listener {
    input-processors =
        <&zip_xy_transform (INPUT_TRANSFORM_X_INVERT | INPUT_TRANSFORM_Y_INVERT)>,
        <&zip_temp_layer 1 30000>;
};

// マウスクリック時にもマウスレイヤーを維持
&mkp_input_listener {
    input-processors = <&zip_temp_layer 1 250>;
};
